
#include <SoftwareSerial.h>         // * Подключаем библиотеку программного последовательного порта
#define RX 8                        // * Определяем вывод TX программного последовательного порта
#define TX 9                        // * Определяем вывод RX программного последовательного порта
                                    //
SoftwareSerial Serial4(RX,TX);      // * Создаём программный последовательный порт
byte data_transmit[5];                       // Объявляем массив для приёма и хранения данных 
int randomNumber = 0;

#include <OneWire.h>                          // подключаем библиотеку для работы с интерфейсом OneWire
OneWire  ds(13);                              // Создаём объект с именем ds, и указанием пина, к которому подключен датчик
OneWire  ds_2(12);                            // Создаём объект с именем ds, и указанием пина, к которому подключен датчик

#include <Wire.h>                             // Подключаем библиотеку для работы с аппаратной шиной I2C.
  
void setup(void) {
  Serial.begin(9600);
  Serial4.begin(9600);              // Инициируем последовательный порт на скорости 9600 бод
  randomSeed(millis());  
  delay(500);                                 // Ждём завершение переходных процессов связанных с подачей питания.     
  }
  
void loop(void) {
  module_1();
//  module_2();    
  delay(30000);
}

void module_1(void) {
  byte i;                                     // задаём переменную для счётчика
  byte present = 0;                           // Флаг сброса шины
  byte type_s;                                // Флаг модели датчика
  byte data[12];                              // массив под значения температуры, считанные с датчика
  byte addr[8];                               // массив под значение адреса датчика
  float celsius, fahrenheit;                  // переменные под значения температуры в градусах Цельсия и Фаренгейта
  
  if ( !ds.search(addr)) {                    // если функция принимает значение false, значит
    Serial.println("No more addresses.");     // больше устройств не найдено. Выводит в монитор порта сообщение об этом.
    Serial.println();                         // добавляем символ новой строки
    ds.reset_search();                        // функция начинает новый поиск устройства.
    delay(250);                               // задержка 250 мсек
    return;
  }
  Serial.print("ROM =");                      // выводим текст в монитор порта. "ROM" - это адрес устройства
  for ( i = 0; i < 8; i++) {                  // запускаем цикл
    Serial.write(' ');                        // между значениями добавляем пробел
    Serial.print(addr[i], HEX);               // в монитор порта побайтово выводим адрес устройства в 16-ричной кодировке
  }
  if (OneWire::crc8(addr, 7) != addr[7]) {    // выполяем проверка контрольной суммы CRC
    Serial.println("CRC is not valid!");      // если контрольная сумма не верна - отправляем в монитор порта сообщение об этом
    return;
  }
  Serial.println();                           // добавляем символ новой строки
  switch (addr[0]) {// Модель датчика температуры                                       Флаг типа модуля                В данном блоке проверяем значение старшего байта полученного адреса и по нему определяем модель модуля
    case 0x10:          Serial.println("  Chip = DS18S20");                             type_s = 1;        break;
    case 0x28:          Serial.println("  Chip = DS18B20");                             type_s = 0;        break;
    case 0x22:          Serial.println("  Chip = DS1822");                              type_s = 0;        break;
    default:            Serial.println("Device is not a DS18x20 family device.");                          return;
  }
  ds.reset();                                 // производим сброс шины перед началом работы с модулем
  ds.select(addr);                            // указываем устройство, с которым далее будет работать код
  ds.write(0x44, 0);                          // отправка команды выполнить конвертацию
  delay(1000);                                // задержка в 1 сек (для выполнения конвертации)
  present = ds.reset();                       // флаг сброса шины перед приёмом данных с модуля
  ds.select(addr);                            // указываем устройство, с которым далее будет работать код
  ds.write(0xBE);                             // считываем значение из scratchpad-памяти модуля
  Serial.print("  Data = ");                  // в монитор порта выводим текст "Значение"
  Serial.print(present, HEX);                 // выводим в монитор порта значение с модуля, в 16-ричной кодировке
  Serial.print(" ");                          // добавляем символ новой строки
  
  for ( i = 0; i < 9; i++) {                  // запускаем цикл считывания 9 байт информации с модуля
    data[i] = ds.read();                      // побайтовое чтение значений с модуля
    Serial.print(data[i], HEX);               // выводим в монитор порта значение байта, считанного с модуля
    Serial.print(" end 1");                        // между значениями добавляем пробел
  }

  Serial.print(" CRC=");                      // выводим в монитор порта текст CRC (контрольная сумма)
  Serial.print(OneWire::crc8(data, 8), HEX);  // выводим в монитор порта значение CRC
  Serial.println();                           // добавляем символ новой строки
  
  int16_t raw = (data[1] << 8) | data[0];     // конвертация значения температуры в 16-битный тип данных
  if (type_s) {                               // если подключена модель DS18S20
    raw = raw << 3;                           // тогда сдвигаем значение на 3 влево для получения 12-битного разрешения точности температуры
    if (data[7] == 0x10) {                    // если указанный бит совпадает с условием, то
      raw = (raw & 0xFFF0) + 12 - data[6];    // пересчитываем сырое значение
    }
  } else {                                    // для всех остальных моделей
    byte cfg = (data[4] & 0x60);              // для задания разрешения вводится переменная (по умолчанию установлено 12-битное разрешение)
    if (cfg == 0x00) raw = raw & ~7;          // если значение переменной и указанного бита совпадают, тогда устанавливается 9-битное разрешение точности
    else if (cfg == 0x20) raw = raw & ~3;     // если значение переменной и указанного бита совпадают, тогда устанавливается 10-битное разрешение точности
    else if (cfg == 0x40) raw = raw & ~1;     // если значение переменной и указанного бита совпадают, тогда устанавливается 11-битное разрешение точности
  }
  celsius = (float)raw / 16.0;                // переводим значения в градусы Цельсия
  fahrenheit = celsius * 1.8 + 32.0;          // переводим значения в градусы Фаренгейта
  Serial.println("  Temperature1 = ");         // выводим в монитор порта текста Температура
  Serial.print(celsius);  
  Serial.println("");
  
  int z = (int)celsius;
  Serial.println(z);
  function_transmit(z, 1);
  delay(1000); 
  }

void module_2(void) {
  byte i_2;                                     // задаём переменную для счётчика
  byte present_2 = 0;                           // Флаг сброса шины
  byte type_s_2;                                // Флаг модели датчика
  byte data_2[12];                              // массив под значения температуры, считанные с датчика
  byte addr_2[8];                               // массив под значение адреса датчика
  float celsius_2, fahrenheit_2;                  // переменные под значения температуры в градусах Цельсия и Фаренгейта
  
if ( !ds_2.search(addr_2)) {                    // если функция принимает значение false, значит
    Serial.println(" 2 No more addresses.");     // больше устройств не найдено. Выводит в монитор порта сообщение об этом.
    Serial.println();                         // добавляем символ новой строки
    ds_2.reset_search();                        // функция начинает новый поиск устройства.
    delay(250);                               // задержка 250 мсек
    return;
  }
  Serial.print("2 ROM =");                      // выводим текст в монитор порта. "ROM" - это адрес устройства
  for ( i_2 = 0; i_2 < 8; i_2++) {                  // запускаем цикл
    Serial.write(' ');                        // между значениями добавляем пробел
    Serial.print(addr_2[i_2], HEX);               // в монитор порта побайтово выводим адрес устройства в 16-ричной кодировке
  }
  if (OneWire::crc8(addr_2, 7) != addr_2[7]) {    // выполяем проверка контрольной суммы CRC
    Serial.println("CRC is not valid!");      // если контрольная сумма не верна - отправляем в монитор порта сообщение об этом
    return;
  }
  Serial.println();                           // добавляем символ новой строки
  switch (addr_2[0]) {// Модель датчика температуры                                       Флаг типа модуля                В данном блоке проверяем значение старшего байта полученного адреса и по нему определяем модель модуля
    case 0x10:          Serial.println("  Chip = DS18S20");                             type_s_2 = 1;        break;
    case 0x28:          Serial.println("  Chip = DS18B20");                             type_s_2 = 0;        break;
    case 0x22:          Serial.println("  Chip = DS1822");                              type_s_2 = 0;        break;
    default:            Serial.println("Device is not a DS18x20 family device.");                          return;
  }
  ds_2.reset();                                 // производим сброс шины перед началом работы с модулем
  ds_2.select(addr_2);                            // указываем устройство, с которым далее будет работать код
  ds_2.write(0x44, 0);                          // отправка команды выполнить конвертацию
  delay(1000);                                // задержка в 1 сек (для выполнения конвертации)
  present_2 = ds_2.reset();                       // флаг сброса шины перед приёмом данных с модуля
  ds_2.select(addr_2);                            // указываем устройство, с которым далее будет работать код
  ds_2.write(0xBE);                             // считываем значение из scratchpad-памяти модуля
  Serial.print("  2 Data = ");                  // в монитор порта выводим текст "Значение"
  Serial.print(present_2, HEX);                 // выводим в монитор порта значение с модуля, в 16-ричной кодировке
  Serial.print(" ");                          // добавляем символ новой строки
  for ( i_2 = 0; i_2 < 9; i_2++) {                  // запускаем цикл считывания 9 байт информации с модуля
    data_2[i_2] = ds_2.read();                      // побайтовое чтение значений с модуля
    Serial.print(data_2[i_2], HEX);               // выводим в монитор порта значение байта, считанного с модуля
    Serial.print(" ");                        // между значениями добавляем пробел
  }

  Serial.print(" CRC=");                      // выводим в монитор порта текст CRC (контрольная сумма)
  Serial.print(OneWire::crc8(data_2, 8), HEX);  // выводим в монитор порта значение CRC
  Serial.println();                           // добавляем символ новой строки
  
  int16_t raw_2 = (data_2[1] << 8) | data_2[0];     // конвертация значения температуры в 16-битный тип данных
  if (type_s_2) {                               // если подключена модель DS18S20
    raw_2 = raw_2 << 3;                           // тогда сдвигаем значение на 3 влево для получения 12-битного разрешения точности температуры
    if (data_2[7] == 0x10) {                    // если указанный бит совпадает с условием, то
      raw_2 = (raw_2 & 0xFFF0) + 12 - data_2[6];    // пересчитываем сырое значение
    }
  } else {                                    // для всех остальных моделей
    byte cfg = (data_2[4] & 0x60);              // для задания разрешения вводится переменная (по умолчанию установлено 12-битное разрешение)
    if (cfg == 0x00) raw_2 = raw_2 & ~7;          // если значение переменной и указанного бита совпадают, тогда устанавливается 9-битное разрешение точности
    else if (cfg == 0x20) raw_2 = raw_2 & ~3;     // если значение переменной и указанного бита совпадают, тогда устанавливается 10-битное разрешение точности
    else if (cfg == 0x40) raw_2 = raw_2 & ~1;     // если значение переменной и указанного бита совпадают, тогда устанавливается 11-битное разрешение точности
  }
  celsius_2 = (float)raw_2 / 16.0;                // переводим значения в градусы Цельсия
  fahrenheit_2 = celsius_2 * 1.8 + 32.0;          // переводим значения в градусы Фаренгейта
  Serial.println("  Temperature2 = ");         // выводим в монитор порта текста Температура
  Serial.print(celsius_2);                      // выводим значения в градусах Цельсия
  Serial.println("");
  
  int z_2 = (int)celsius_2;
  Serial.println(z_2);
  function_transmit(z_2, 2);
  delay(1000); 
  }

void function_transmit(int x, int module) {
  byte data[5];                       // Объявляем массив для приёма и хранения данных 
  int randomNumber = 0;
  Serial.println("function_transmit++");
  Serial.println(x);

  digitalWrite(11,1);//pin on
  randomNumber = random(101);
//  data[0] = 0;                      // Записываем ноль (ВЫКЛ) в первый байт массива
//  data[1] = 3;
//  data[2] = byte(randomNumber);     //sim temperature
//  Serial4.write(0xAA);              // Посылаем заголовок пакета
//  Serial4.write(data, sizeof(data));// Посылаем массив данных
//  Serial4.write('\n');              // Посылаем символ новой строки
  
  delay(10000);                       // Ждём полсекунды
  digitalWrite(11,0);//pin off
  data[0] = 1;                      // Записываем единицу (ВКЛ) в первый байт массива
  data[1] = byte(module);
  data[2] = byte(x);
  Serial4.write(0xAA);              // Посылаем заголовок пакета
  Serial4.write(data, sizeof(data));// Посылаем массив данных
  Serial4.write('\n');              // Посылаем символ новой строки
          
  delay(10000);                       // Ждём полсекунды
  }
